#include <AFMotor.h>
#include <SPI.h>
#include <Wire.h>
#include <Adafruit_GFX.h>
#include <Adafruit_SSD1306.h>
#include <Servo.h> 
Servo myservo; 
int pos = 0;
#define SCREEN_WIDTH 128
#define SCREEN_HEIGHT 64
#define trigPin 2
#define echoPin 3

Adafruit_SSD1306 display(SCREEN_WIDTH, SCREEN_HEIGHT, &Wire, -1);

// C'est notre photo qui s'affiche sur l'écran:

const unsigned char krose [] PROGMEM = {

0x00, 0x7f, 0xff, 0xff, 0xff, 0xff, 0xff, 0xff, 0xff, 0xff, 0xff, 0xff, 0xff, 0xff, 0xff, 0xff,
0x01, 0xff, 0xff, 0xff, 0xff, 0xff, 0xff, 0xff, 0xff, 0xff, 0xff, 0xff, 0xff, 0xff, 0xff, 0xff,
0x03, 0xff, 0xff, 0xff, 0xff, 0xff, 0xff, 0xff, 0xff, 0xff, 0xff, 0xff, 0xff, 0xff, 0xff, 0xff,
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0xff, 0xf8, 0x01, 0xff, 0xff, 0xff, 0xff, 0xff, 0xe0, 0x00, 0x00, 0x00, 0x1d, 0x80, 0x44, 0x00
};


void ssetup() 
{ 
display.begin(SSD1306_SWITCHCAPVCC, 0x3C); 
myservo.attach(10); 
}

void Lloop() {
display.clearDisplay();
display.drawBitmap(0, 0, krose , 128,64,1);
display.display();
delay(5000);
display.clearDisplay();
}

char command;
void Ssetup() {
myservo.attach(10); // On a inseré dans SER1
Serial.begin(9600);
pinMode(trigPin, OUTPUT);
pinMode(echoPin, INPUT);
display.begin(SSD1306_SWITCHCAPVCC, 0x3C);
display.clearDisplay(); 
}
AF_DCMotor motor1(1); 
AF_DCMotor motor3(3); 

char Ccommand;

void setup() {

Serial.begin(9600);
myservo.attach(10);
}

void loop() {
if(Serial.available()>0)
{
command = Serial.read();
delay(2);

switch(command)
{
case 'F':
forward();
break;
case'B':
backward();
break;
case 'L':
left();
break;
case 'R':
right();
break;
case 'G':
forwardleft();
break;
case 'I':
forwardright();
break;
case 'H':
backwardleft();
break;
case 'J':
backwardright();
break;
case 'S':
Stop();
break;
case 'V':
hornon();
break;
case 'U':
backlightson();
break;
}
}
}

void forward()
{
motor1.setSpeed(255);
motor1.run(FORWARD);
motor3.setSpeed(255);
motor3.run(FORWARD);
}

void backward()
{
motor1.setSpeed(255);
motor1.run(BACKWARD);
motor3.setSpeed(255);
motor3.run(BACKWARD);
}

void left()
{
motor1.setSpeed(255);
motor1.run(FORWARD);
motor3.setSpeed(255);
motor3.run(BACKWARD);
}

void right()
{
motor1.setSpeed(255);
motor1.run(BACKWARD);
motor3.setSpeed(255);
motor3.run(FORWARD);
}

void forwardleft()
{
motor1.setSpeed(250);
motor1.run(FORWARD);
motor3.setSpeed(10);
motor3.run(FORWARD);
}

void forwardright()
{
motor1.setSpeed(10);
motor1.run(FORWARD);
motor3.setSpeed(255);
motor3.run(FORWARD);
}

void backwardleft()
{
motor1.setSpeed(10);
motor1.run(BACKWARD);
motor3.setSpeed(255);
motor3.run(BACKWARD);
}

void backwardright()
{
motor1.setSpeed(255);
motor1.run(BACKWARD);
motor3.setSpeed(10);
motor3.run(BACKWARD);
}

void Stop()
{
motor1.setSpeed(0); 
motor1.run(RELEASE); 
motor3.setSpeed(0); 
motor3.run(RELEASE);
}

// Les Fonctions du servo:

void hornon(){ // c'est le Horn ON (Claxon) pour activer le servo en ce mode
for(pos = 0; pos < 180; pos += 1) 
{ 
myservo.write(pos); 
delay(15); 
}
for(pos = 180; pos>=1; pos-=1) 
{ 
myservo.write(pos); 
delay(15); 
}
}

void backlightson(){  // c'est le Backlights ON, on a choisit cette touche pour changer le mode de l'hélice
for(pos = 0; pos < 0; pos += 1) 
{ 
myservo.write(pos); 
delay(0); 
}
for(pos = 0; pos>=0; pos-=1) 
{ 
myservo.write(pos); 
delay(0); 
}
}

